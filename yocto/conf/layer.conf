## yocto/conf/layer.conf
```bitbake
BBPATH .= ":${LAYERDIR}"

BBFILES += " \
    ${LAYERDIR}/recipes-*/*/*.bb \
    ${LAYERDIR}/recipes-*/*/*.bbappend \
"

BBFILE_COLLECTIONS += "meta-immersive"
BBFILE_PATTERN_meta-immersive = "^${LAYERDIR}/"
BBFILE_PRIORITY_meta-immersive = "10"

LAYERDEPENDS_meta-immersive = "core raspberrypi"
LAYERSERIES_COMPAT_meta-immersive = "scarthgap styhead"
```

## yocto/conf/machine/immersive-pi.conf
```bitbake
# Immersive 360 node machine — Raspberry Pi 4 (64-bit).
#
# One image serves both roles (render | control); the role is read at boot from
# immersive.conf on the boot FAT. Pi 4 is the render board because it keeps the
# H.264 hardware decoder (v4l2h264dec) for 12 always-on nodes; the control node
# runs the same image and renders no video.
require conf/machine/raspberrypi4-64.conf

# Full KMS (vc4-kms-v3d) — the render stage drives DRM/KMS/GBM directly, no
# compositor. fkms is not enough for headless GLES2-over-GBM.
VC4DTBO = "vc4-kms-v3d"

# HDMI always live so a projector that is slow to handshake still gets a signal.
HDMI_FORCE_HOTPLUG = "1"

# CMA for 1080p hardware decode + GL textures on every node.
GPU_MEM = "256"

# Appliance: no on-screen serial console, no rainbow splash, silent boot.
SERIAL_CONSOLES = ""
DISABLE_SPLASH = "1"
ENABLE_UART = "1"
DISABLE_OVERSCAN = "1"

BOOTDD_VOLUME_ID = "boot"
SDIMG_VFAT_LABEL = "boot"
# 256 MB boot — all Pi DTBs/overlays overflow 128 MB.
BOOT_SPACE = "262144"
```
